## CMakeLists.txt
```
cmake_minimum_required(VERSION 3.20.0)

# Initialize Zephyr
find_package(Zephyr REQUIRED HINTS $ENV{ZEPHYR_BASE})
project(wasm_embedded_app)

# WAMR Config: Required settings for WASM Micro Runtime
set(WAMR_BUILD_TARGET "X86_32" CACHE STRING "Target architecture")
set(WAMR_BUILD_AOT 0 CACHE BOOL "Disable AOT (we use JIT/Interpreter for Wasm)")
set(WAMR_BUILD_INTERP 1 CACHE BOOL "Enable Interpreter")
set(WAMR_BUILD_FAST_INTERP 1 CACHE BOOL "Enable Fast Interpreter")
set(WAMR_BUILD_WASI_MINCORE 1 CACHE BOOL "Enable WASI Mincore")
set(WAMR_BUILD_REF_TYPES 1 CACHE BOOL "Enable Reference Types")
set(WAMR_BUILD_LIBC_WASI 1 CACHE BOOL "Enable WASI")
set(WAMR_BUILD_LIBC_WASI_NETWORK 1 CACHE BOOL "Enable WASI Socket Networking")
set(WAMR_BUILD_LIBC_BUILTIN 1 CACHE BOOL "Enable Builtin libc")
if(DEFINED ENV{WAMR_BASE})
    set(WAMR_DIR $ENV{WAMR_BASE})
else()
    # Fallback to typical Zephyr module path if WAMR is fetched via west
    set(WAMR_DIR ${ZEPHYR_BASE}/../modules/lib/wamr)
endif()

# Include WAMR core if it exists
if(EXISTS ${WAMR_DIR}/build-scripts)
    set(WAMR_BUILD_PLATFORM "zephyr")
    set(WAMR_ROOT_DIR ${WAMR_DIR})
    include(${WAMR_DIR}/build-scripts/runtime_lib.cmake)
else()
    message(WARNING "WAMR directory not found at ${WAMR_DIR}. Make sure 'west update' has fetched it.")
endif()

# Add our application source code
target_sources(app PRIVATE ${WAMR_RUNTIME_LIB_SOURCE} src/main.c)

# Include the directory containing our generated `hello_wasm_payload.h`
target_include_directories(app PRIVATE ${CMAKE_CURRENT_SOURCE_DIR}/../../hello-wasm)
```

## prj.conf
```kconfig
# Enable C++ support if WAMR requires it internally
CONFIG_CPP=y
CONFIG_STD_CPP17=y

# Standard C Library (Newlib required for WASI features)
CONFIG_NEWLIB_LIBC=y

# Memory management (WASM requires dynamic allocation)
CONFIG_HEAP_MEM_POOL_SIZE=131072
CONFIG_MAIN_STACK_SIZE=8192

# Enable WAMR (assumes the wamr module is in Zephyr's west workspace)
# Note: depending on the Zephyr version and how WAMR is integrated,
# this might be named CONFIG_WASM or CONFIG_WAMR.
# CONFIG_WASM=y

# Networking and POSIX support for WASI sockets
CONFIG_NETWORKING=y
CONFIG_NET_IPV4=y
CONFIG_NET_IPV6=y
CONFIG_NET_SOCKETS=y
CONFIG_POSIX_API=y

# File system for WASI
CONFIG_FILE_SYSTEM=y
CONFIG_FILE_SYSTEM_LITTLEFS=y
CONFIG_FLASH=y
CONFIG_FLASH_MAP=y
CONFIG_FLASH_PAGE_LAYOUT=y

# Networking: Enable Ethernet & QEMU User Networking (SLIRP / NAT)
CONFIG_NET_L2_ETHERNET=y
CONFIG_NET_ARP=y

# Assegnazione di un IP fittizio NAT alla board (QEMU default SLIRP router: 10.0.2.2)
CONFIG_NET_CONFIG_SETTINGS=y
CONFIG_NET_CONFIG_MY_IPV4_ADDR="10.0.2.15"
CONFIG_NET_CONFIG_MY_IPV4_GW="10.0.2.2"
CONFIG_NET_CONFIG_MY_IPV4_NETMASK="255.255.255.0"

# Abilita driver Ethernet nativo per QEMU
CONFIG_NET_QEMU_ETHERNET=y

# Attiva il socket SLIP virtuale verso l'host
# CONFIG_NET_QEMU_SLIP=y
CONFIG_PCIE=y
CONFIG_ETH_E1000=y
CONFIG_NET_QEMU_USER=y
# CONFIG_NET_LOOPBACK=y
CONFIG_NET_TCP=y
```

## src/main.c
```c
#include <zephyr/kernel.h>
#include <stdio.h>
#include <stdlib.h>

// WAMR headers (make sure WAMR is properly fetched via west)
#include "wasm_export.h"

// Include the Wasm payload we generated via xxd!
#include "hello_wasm_payload.h"

int main(void) {
    printk("===============================================\n");
    printk(" OCRE Wasm Sandbox - Master Thesis Application \n");
    printk("===============================================\n");

    printk("\nPayload Info:\n");
    printk("- Wasm Size: %d bytes\n", hello_wasm_app_len);
    printk("- Wasm Magic Header: 0x%02x 0x%02x 0x%02x 0x%02x\n\n", 
           hello_wasm_app[0], hello_wasm_app[1], hello_wasm_app[2], hello_wasm_app[3]);

    /*
     * INTERGRATION TODO FOR MASTER THESIS:
     * 1. Ensure Zephyr's west workspace has pulled the WAMR module.
     * 2. Uncomment the WASM runtime initialization below.
     * 3. Compile and Run via `west build` in the Dev Container.
     */

    static char global_heap_buf[2 * 1024 * 1024];
    RuntimeInitArgs init_args;
    memset(&init_args, 0, sizeof(RuntimeInitArgs));

    init_args.mem_alloc_type = Alloc_With_Pool;
    init_args.mem_alloc_option.pool.heap_buf = global_heap_buf;
    init_args.mem_alloc_option.pool.heap_size = sizeof(global_heap_buf);

    if (!wasm_runtime_full_init(&init_args)) {
        printk("Init runtime environment failed.\n");
        return -1;
    }

    char error_buf[128];
    wasm_module_t module = wasm_runtime_load(hello_wasm_app, hello_wasm_app_len, error_buf, sizeof(error_buf));
    if (!module) {
        printk("Load wasm module failed. Error: %s\n", error_buf);
        return -1;
    }

    // Pass address pool to allow WASI Socket external connections
    // The format is "addr/mask". We allow the entire local subnet.
    const char *addr_pool[1] = { "10.0.2.0/24" };

    wasm_runtime_set_wasi_args(module, NULL, 0, NULL, 0, NULL, 0, NULL, 0);
    wasm_runtime_set_wasi_addr_pool(module, addr_pool, 1);

    wasm_module_inst_t module_inst = wasm_runtime_instantiate(module, 64 * 1024, 128 * 1024, error_buf, sizeof(error_buf));
    if (!module_inst) {
        printk("Instantiate wasm module failed. Error: %s\n", error_buf);
        return -1;
    }

    printk("Executing Wasm module...\n");
    if (!wasm_application_execute_main(module_inst, 0, NULL)) {
        printk("Execution failed. Error: %s\n", wasm_runtime_get_exception(module_inst));
    } else {
        printk("Execution successful.\n");
    }
    
    // Cleanup
    wasm_runtime_deinstantiate(module_inst);
    wasm_runtime_unload(module);
    wasm_runtime_destroy();

    printk("\nReady for Zephyr Runtime Execution.\n");
    return 0;
}
```
